## components/app_config/Kconfig.projbuild
```kconfig
menu "Configuração do Projeto"

config WIFI_SSID
    string "WiFi SSID"
    default ""

config WIFI_PASSWORD
    string "WiFi Password"
    default ""

config MQTT_BROKER_URI
    string "MQTT Broker URI"
    default "mqtt://broker.hivemq.com"

endmenu

menu "Configuração OLAF"

    # =========================================================
    # SENSOR DA PORTA
    # =========================================================

    menu "Sensor da Porta"

        config OLAF_DOOR_GPIO
            int "GPIO do sensor da porta"
            default 5
            range 0 48
            help
                GPIO utilizado pelo sensor de porta E18-D80NK.

        config OLAF_DOOR_CLOSED_LEVEL
            int "Nível lógico da porta fechada"
            default 0
            range 0 1
            help
                Nível lógico que representa a porta como fechada.
                0 = LOW
                1 = HIGH.

        config OLAF_DOOR_DEBOUNCE_MS
            int "Tempo de debounce da porta (ms)"
            default 80
            range 0 10000
            help
                Tempo durante o qual o sinal do sensor da porta
                deve permanecer estável antes que uma mudança
                de estado seja aceita.

    endmenu


    # =========================================================
    # LEDS E BUZZER
    # =========================================================

    menu "Saídas"

        config OLAF_DOOR_LED_GPIO
            int "GPIO do LED de alerta da porta"
            default 35
            range 0 48
            help
                GPIO utilizado pelo LED de alerta da porta.

        config OLAF_TEMP_LED_GPIO
            int "GPIO do LED de alerta de temperatura"
            default 42
            range 0 48
            help
                GPIO utilizado pelo LED de alerta de temperatura.

        config OLAF_RECOVERY_LED_GPIO
            int "GPIO do LED de recuperação térmica"
            default 2
            range 0 48
            help
                GPIO utilizado pelo LED de recuperação térmica.

        config OLAF_BUZZER_GPIO
            int "GPIO do buzzer"
            default 36
            range 0 48
            help
                GPIO utilizado pelo buzzer piezoelétrico ativo.

    endmenu


    # =========================================================
    # ADC - NTC
    # =========================================================

    menu "ADC do NTC"

        choice OLAF_NTC_ADC_UNIT
            prompt "Unidade ADC"
            default OLAF_NTC_ADC_UNIT_1

            config OLAF_NTC_ADC_UNIT_1
                bool "ADC1"

            config OLAF_NTC_ADC_UNIT_2
                bool "ADC2"

        endchoice


        choice OLAF_NTC_ADC_CHANNEL
            prompt "Canal ADC"
            default OLAF_NTC_ADC_CHANNEL_3

            config OLAF_NTC_ADC_CHANNEL_0
                bool "Canal 0"

            config OLAF_NTC_ADC_CHANNEL_1
                bool "Canal 1"

            config OLAF_NTC_ADC_CHANNEL_2
                bool "Canal 2"

            config OLAF_NTC_ADC_CHANNEL_3
                bool "Canal 3"

            config OLAF_NTC_ADC_CHANNEL_4
                bool "Canal 4"

            config OLAF_NTC_ADC_CHANNEL_5
                bool "Canal 5"

            config OLAF_NTC_ADC_CHANNEL_6
                bool "Canal 6"

            config OLAF_NTC_ADC_CHANNEL_7
                bool "Canal 7"

            config OLAF_NTC_ADC_CHANNEL_8
                bool "Canal 8"

            config OLAF_NTC_ADC_CHANNEL_9
                bool "Canal 9"

        endchoice


        choice OLAF_NTC_ADC_ATTEN
            prompt "Atenuação do ADC"
            default OLAF_NTC_ADC_ATTEN_12

            config OLAF_NTC_ADC_ATTEN_0
                bool "0 dB"

            config OLAF_NTC_ADC_ATTEN_2_5
                bool "2,5 dB"

            config OLAF_NTC_ADC_ATTEN_6
                bool "6 dB"

            config OLAF_NTC_ADC_ATTEN_12
                bool "12 dB"

        endchoice

    endmenu


    # =========================================================
    # TERMISTOR NTC
    # =========================================================

    menu "Parâmetros do NTC"

        config OLAF_NTC_R0_OHM
            int "Resistência nominal do NTC (ohms)"
            default 10000
            range 100 1000000
            help
                Resistência nominal do NTC na temperatura de referência.

        config OLAF_NTC_T0_X10
            int "Temperatura de referência do NTC (°C x10)"
            default 250
            range -400 1500
            help
                Temperatura de referência do NTC multiplicada por 10.
                Exemplo: 25,0 °C = 250.

        config OLAF_NTC_BETA
            int "Constante Beta do NTC"
            default 3950
            range 100 10000
            help
                Constante Beta do NTC.

        config OLAF_NTC_FIXED_R_OHM
            int "Resistência do resistor fixo (ohms)"
            default 10000
            range 100 1000000
            help
                Resistência do resistor fixo utilizado no divisor
                de tensão do NTC.

        config OLAF_ADC_SUPPLY_MV
            int "Tensão de alimentação do ADC (mV)"
            default 3300
            range 1000 5000
            help
                Tensão de alimentação utilizada pelo divisor
                de tensão do NTC.

        config OLAF_TEMP_ADC_SAMPLES
            int "Amostras do ADC por leitura de temperatura"
            default 32
            range 1 1024
            help
                Quantidade de amostras do ADC utilizadas para
                calcular a média da leitura de temperatura.

    endmenu


    # =========================================================
    # INTERVALOS DA APLICAÇÃO
    # =========================================================

    menu "Temporização da Aplicação"

        config OLAF_APP_PERIOD_MS
            int "Período da aplicação (ms)"
            default 200
            range 1 60000
            help
                Período da tarefa principal da aplicação.

        config OLAF_TEMP_READ_PERIOD_MS
            int "Período de leitura da temperatura (ms)"
            default 1000
            range 1 600000
            help
                Intervalo entre as leituras de temperatura.

    endmenu


    # =========================================================
    # TEMPERATURA
    # =========================================================

    menu "Alarme de Temperatura"

        config OLAF_TEMP_NORMAL_MIN_X10
            int "Temperatura mínima normal (°C x10)"
            default 240
            range -400 1500
            help
                Temperatura mínima normal multiplicada por 10.
                Exemplo: 24,0 °C = 240.

        config OLAF_TEMP_NORMAL_MAX_X10
            int "Temperatura máxima normal (°C x10)"
            default 350
            range -400 1500
            help
                Temperatura máxima normal multiplicada por 10.
                Exemplo: 35,0 °C = 350.

        config OLAF_TEMP_ALARM_HIGH_X10
            int "Temperatura para alarme de alta temperatura (°C x10)"
            default 360
            range -400 1500
            help
                Temperatura para ativação do alarme de alta temperatura,
                multiplicada por 10.
                Exemplo: 36,0 °C = 360.

        config OLAF_TEMP_ALARM_CLEAR_X10
            int "Limite para limpar o alarme de temperatura (°C x10)"
            default 280
            range -400 1500
            help
                Temperatura abaixo da qual o alarme pode ser limpo,
                multiplicada por 10.
                Exemplo: 28,0 °C = 280.

    endmenu


    # =========================================================
    # TIMEOUT ADAPTATIVO
    # =========================================================

    menu "Timeout Adaptativo"

        config OLAF_TIMEOUT_BASE_S
            int "Timeout base (segundos)"
            default 300
            range 1 86400
            help
                Timeout base utilizado pelo algoritmo adaptativo.

        config OLAF_TIMEOUT_MIN_S
            int "Timeout mínimo (segundos)"
            default 30
            range 1 86400
            help
                Menor timeout permitido pelo algoritmo adaptativo.

        config OLAF_TIMEOUT_MAX_S
            int "Timeout máximo (segundos)"
            default 420
            range 1 86400
            help
                Maior timeout permitido pelo algoritmo adaptativo.

    endmenu


    # =========================================================
    # RECUPERAÇÃO TÉRMICA
    # =========================================================

    menu "Recuperação Térmica"

        config OLAF_RECOVERY_TARGET_S
            int "Tempo de referência para recuperação (segundos)"
            default 300
            range 1 86400
            help
                Tempo de recuperação utilizado como referência
                pelo algoritmo de timeout adaptativo.

        config OLAF_RECOVERY_STABLE_S
            int "Tempo de estabilidade da recuperação (segundos)"
            default 20
            range 1 3600
            help
                Tempo durante o qual a temperatura deve permanecer
                estável antes que a recuperação seja considerada concluída.

    endmenu


    # =========================================================
    # MÉDIAS MÓVEIS
    # =========================================================

    menu "Médias Móveis"

        config OLAF_BASELINE_ALPHA_X1000
            int "Alpha da média móvel do baseline (x1000)"
            default 20
            range 1 1000
            help
                Valor de alpha multiplicado por 1000.
                Exemplo: 0,02 = 20.

        config OLAF_RECOVERY_ALPHA_X1000
            int "Alpha da média móvel da recuperação (x1000)"
            default 200
            range 1 1000
            help
                Valor de alpha multiplicado por 1000.
                Exemplo: 0,20 = 200.

    endmenu


    # =========================================================
    # LED
    # =========================================================

    menu "LED"

        config OLAF_LED_BLINK_PERIOD_MS
            int "Período de piscagem do LED (ms)"
            default 500
            range 1 60000
            help
                Período utilizado para a piscagem dos LEDs de alerta.

    endmenu


    # =========================================================
    # BUZZER
    # =========================================================

    menu "Buzzer"

        config OLAF_BUZZER_SHORT_BEEP_MS
            int "Duração do beep curto (ms)"
            default 90
            range 1 60000
            help
                Duração de um beep curto do buzzer.

        config OLAF_BUZZER_SHORT_PAUSE_MS
            int "Pausa entre beeps curtos (ms)"
            default 80
            range 0 60000
            help
                Pausa entre os beeps curtos do buzzer.

        config OLAF_BUZZER_ALERT_ON_MS
            int "Duração do buzzer ligado (ms)"
            default 1000
            range 1 60000
            help
                Duração do estado ligado do buzzer durante um alerta.

        config OLAF_BUZZER_ALERT_OFF_MS
            int "Duração do buzzer desligado (ms)"
            default 1000
            range 0 60000
            help
                Duração do estado desligado do buzzer durante um alerta.

    endmenu

endmenu
```
